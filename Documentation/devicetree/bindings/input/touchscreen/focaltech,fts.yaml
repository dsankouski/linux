## Documentation/devicetree/bindings/input/touchscreen/focaltech,fts.yaml
```yaml
# SPDX-License-Identifier: (GPL-2.0-only OR BSD-2-Clause)
%YAML 1.2
---
$id: http://devicetree.org/schemas/input/touchscreen/focaltech,fts.yaml#
$schema: http://devicetree.org/meta-schemas/core.yaml#

title: Focaltech FTS I2C Touchscreen Controller

maintainers:
  - Joel Selvaraj <joelselvaraj.oss@gmail.com>
  - Caleb Connolly <caleb@connolly.tech>

allOf:
  - $ref: touchscreen.yaml#

properties:
  compatible:
    enum:
      - focaltech,fts5452
      - focaltech,fts8719
  reg:
    const: 0x38

  interrupts:
    maxItems: 1

  reset-gpios:
    maxItems: 1

  avdd-supply:
    description: a phandle for the regulator supplying analog power (2.6V to 3.3V).

  vddio-supply:
    description: a phandle for the regulator supplying IO power (1.8V).

  focaltech,max-touch-number:
    $ref: /schemas/types.yaml#/definitions/uint32
    description: max number of fingers supported
    minimum: 2
    maximum: 10

  touchscreen-size-x: true
  touchscreen-size-y: true

additionalProperties: false

required:
  - compatible
  - reg
  - reset-gpios
  - focaltech,max-touch-number
  - touchscreen-size-x
  - touchscreen-size-y

examples:
  - |
    #include <dt-bindings/interrupt-controller/irq.h>
    #include <dt-bindings/gpio/gpio.h>
    &i2c5 {
      status="okay";

      touchscreen: focaltech@38 {
        compatible = "focaltech,fts8719";
        reg = <0x38>;
        interrupt-parent = <&tlmm>;
        interrupts = <31 IRQ_TYPE_EDGE_RISING>;

        avdd-supply = <&vreg_l28a_3p0>;
        vddio-supply = <&vreg_l14a_1p8>;

        pinctrl-names = "default", "sleep";
        pinctrl-0 = <&ts_int_default &ts_reset_default>;
        pinctrl-1 = <&ts_int_sleep &ts_reset_sleep>;

        reset-gpios = <&tlmm 32 GPIO_ACTIVE_LOW>;

        touchscreen-size-x = <1080>;
        touchscreen-size-y = <2246>;
        focaltech,max-touch-number = <10>;
      };
    };
```

## Documentation/devicetree/bindings/regulator/samsung,s2dos05.yaml
```yaml
# SPDX-License-Identifier: (GPL-2.0 OR BSD-2-Clause)
%YAML 1.2
---
$id: http://devicetree.org/schemas/regulator/samsung,s2dos05.yaml#
$schema: http://devicetree.org/meta-schemas/core.yaml#

title: Samsung s2dos05 regulator

maintainers:
  - Dzmitry Sankouski <dsankouski@gmail.com>

description: |
  The S2DOS05 is a companion power management IC for the smart phones. 
  Has 4 LDO and 1 BUCK regulators, and has capability to measure 
  current and power. Can detect short circuit on outputs.

properties:
  compatible:
    const: samsung,s2dos05pmic
  reg:
    maxItems: 1

  regulators:
    type: object
    description: List of regulators and its properties

    patternProperties:
      "^s2dos05-buck1|s2dos05-ldo[1-4]$":
        type: object
        $ref: "regulator.yaml#"
        unevaluatedProperties: false

    additionalProperties: false

required:
  - compatible
  - reg
  - regulators

additionalProperties: false

examples:
  - |
    regulator@60 {
    	compatible = "samsung,s2dos05pmic";
    	reg = <0x60>;
    	adc_mode = <0x2>;
    	adc_sync_mode = <0x2>;
    	pinctrl-names = "default";
    	pinctrl-0 = <&s2dos05_irq>;
    	s2dos05,s2dos05_int = <&tlmm 0x31 0x0>;
    
    	regulators {
    		s2dos05_ldo1: s2dos05-ldo1 {
    			regulator-name = "s2dos05-ldo1";
    			regulator-min-microvolt = <0x16e360>;
    			regulator-max-microvolt = <0x1e8480>;
    			regulator-active-discharge = <0x1>;
                   regulator-always-on;
    		};
    
    		s2dos05_ldo2: s2dos05-ldo2 {
    			regulator-name = "s2dos05-ldo2";
    			regulator-min-microvolt = <0x1b7740>;
    			regulator-max-microvolt = <0x1b7740>;
    			regulator-active-discharge = <0x1>;
    			regulator-boot-on;
                   regulator-always-on;
    		};
    
    		s2dos05_ldo3: s2dos05-ldo3 {
    			regulator-name = "s2dos05-ldo3";
    			regulator-min-microvolt = <0x2dc6c0>;
    			regulator-max-microvolt = <0x2dc6c0>;
    			regulator-active-discharge = <0x1>;
    			regulator-boot-on;
    			regulator-always-on;
    		};
    
    		s2dos05_ldo4: s2dos05-ldo4 {
    			regulator-name = "s2dos05-ldo4";
    			regulator-min-microvolt = <0x2932e0>;
    			regulator-max-microvolt = <0x399a18>;
    			regulator-active-discharge = <0x1>;
    			regulator-always-on;
    		};
    
    		s2dos05_buck1: s2dos05-buck1 {
    			regulator-name = "s2dos05-buck1";
    			regulator-min-microvolt = <0xcf850>;
    			regulator-max-microvolt = <0x200b20>;
    			regulator-active-discharge = <0x1>;
    			regulator-always-on;
    		};
    	};
    };
```

## sound/soc/codecs/max98512-downstream/Kconfig
```kconfig
#


menu "menu"

config SND_SOC_MAX98512
	bool
	default y
	help
		Maxim

config SND_SOC_MAXIM_DSM
	bool
	default y
	help
		Maxim

config SND_SOC_MAXIM_DSM_CAL
	bool
	default y
	help
		Maxim

endmenu
```
